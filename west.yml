## west.yml
```yaml
manifest:
  remotes:
    - name: LairdCP
      url-base: https://github.com/LairdCP
    - name: KMcNickel
      url-base: https://github.com/KMcNickel
    - name: ncs
      url-base: https://github.com/nrfconnect      

  # Please add items below based on alphabetical order.
  # These dependencies may need updating if new features are added to the firmware.
  projects:
    - name: Pinnacle_100_base
      path: pinnacle_100_base
      revision: main
      remote: KMcNickel
    - name: sdk-nrf
      path: nrf
      revision: 4c0d3be2ed4ade4dc3e614e95e6f8e4330d663b4
      remote: ncs
      import: true      
    - name: zephyr
      west-commands: scripts/west-commands.yml
      revision: e144cc2562d9b09d23608fa67fc17af36fccd0ab
      remote: LairdCP
      import: true
    - name: zephyr_boards
      path: zephyr/boards/arm
      revision: d921397ac677e933c479bd59ff22cbba5abb1e4c
      remote: LairdCP
    - name: zephyr_framework
      path: modules/framework
      revision: 998509f5097ae8cbc2c9b1e0df5453b356814a38
      remote: LairdCP
    - name: zephyr_lib
      path: modules/zephyr_lib
      revision: dd6e9c0403f0f695f45a8afe3588ae6c0bfbea01
      remote: LairdCP

  self:
    path: pinnacle_100_oob_public_manifest
```
